## Kconfig
```kconfig
menuconfig PAW3222
  bool "PAW3222 mouse optical sensor"
  select SPI
  depends on INPUT
  depends on DT_HAS_XINTA_PAW3222_ENABLED
  help
      Enable PAW3222 mouse optical sensor.

if PAW3222

module = PAW3222
module-str = PAW3222
source "${ZEPHYR_BASE}/subsys/logging/Kconfig.template.log_config"

endif #PAW3222

config ZMK_PAW3222_STUDIO_RPC
    bool "Enable PAW3222 custom Studio RPC"
    depends on ZMK_STUDIO
    select ZMK_PAW3222_PROTOBUF
    help
      Custom (unofficial) ZMK Studio RPC subsystem exposing PAW3222 sensor
      info and diagnostics. Works with zero PAW3222 devices present (e.g.
      native_sim), so it does not depend on CONFIG_PAW3222 directly.

config ZMK_PAW3222_PROTOBUF
    bool
    select NANOPB
    imply NANOPB_NO_ERRMSG
    imply NANOPB_WITHOUT_64BIT
    imply NANOPB_NO_ENCODE_SIZE_CHECK
    select ZMK_LOW_PRIORITY_WORK_QUEUE

config ZMK_PAW3222_CUSTOM_SETTINGS
    bool "Enable PAW3222 runtime settings via zmk-feature-custom-settings"
    depends on ZMK_CUSTOM_SETTINGS
    help
      Registers PAW3222 sensor parameters (cpi, force-awake) as custom
      settings (subsystem "xinta__paw3222"), readable/writable over the
      generic custom-settings Studio RPC subsystem and persisted via the
      Zephyr settings subsystem. Works with zero PAW3222 devices present.
```

## dts/bindings/xinta,paw3222.yml
```yaml
description: |
  Sensor driver for the PixArt PAW3222 optical mouse sensor

compatible: "xinta,paw3222"

include: spi-device.yaml

properties:
  irq-gpios:
    type: phandle-array
    required: true
    description: GPIO connected to the motion pin, active low.

  power-gpios:
    type: phandle-array
    required: false
    description: GPIO connected to the power control pin.

  cpi:
    type: int
    description: CPI resolution for the sensor (range 608 - 4826, step 38).

  evt-type:
    type: int
    required: true

  x-input-code:
    type: int
    required: true

  y-input-code:
    type: int
    required: true

  force-awake:
    type: boolean
    description: Initialize the sensor in "force awake" mode.

  disable-burst-read:
    type: boolean
    description: |
      If true, disables burst read and uses single register reads for motion data.

  settings-id:
    type: string
    description: |
      Stable short id (up to 8 ASCII characters) used to build this device's
      per-device custom setting keys ("<param>@<id>").
```
